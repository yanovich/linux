## Documentation/devicetree/bindings/misc/lp8x4x-bus.txt
```
Custom parallel bus on ICP DAS LP-8x4x industrial computers

See Documentation/misc-devices/lp8x4x_bus.txt for details.

Required properties:
- compatible : should be "icpdas,backplane-lp8x4x"

- reg: physical base addresses and region lengths of
       * the rotary switch
       * the 8bit DIP switch
       * the slot count register

- eeprom-gpios : should point to active-low write enable GPIO

Example:

	backplane {
		compatible = "icpdas,backplane-lp8x4x";
		reg = <0x0 0x2
		       0x9002 0x2
		       0x9046 0x2>;
		eeprom-gpios = <&gpio 4 0>;
	};
```

## Documentation/devicetree/bindings/rtc/rtc-ds1302.txt
```
* Dallas Semiconductor DS-1302 RTC

Simple device which could be used to store date/time between reboots.

Required properties:
- compatible : Should be "ds,rtc-ds1302"
- reg : Should be address and size of IO memory region

Examples:

rtc@40900000 {
	compatible = "ds,rtc-ds1302";
	reg = <0x1700901c 0x1>;
};
```

## Documentation/devicetree/bindings/serial/lp8x4x-serial.txt
```
UART ports on ICP DAS LP-8x4x

ICP DAS LP-8x4x contains three additional serial ports interfaced via
Analog Devices ADM213EA chips in addition to 3 serial ports on PXA CPU.

Required properties:
- compatible : should be "icpdas,uart-lp8x4x"

- reg : should provide 16 byte man IO memory region and 1 byte region for
	termios

- interrupts : should provide interrupt

- interrupt-parent : should provide a link to interrupt controller either
		     explicitly or implicitly from a parent node

Examples (from pxa27x-lp8x4x.dts):

		uart@9050 {
			compatible = "icpdas,uart-lp8x4x";
			reg = <0x9050 0x10
			       0x9030 0x02>;
			interrupt-parent = <&fpgairg>;
			interrupts = <13>;
			status = "okay";
		};

		uart@9060 {
			compatible = "icpdas,uart-lp8x4x";
			reg = <0x9060 0x10
			       0x9032 0x02>;
			interrupt-parent = <&fpgairg>;
			interrupts = <14>;
			status = "okay";
		};
```
